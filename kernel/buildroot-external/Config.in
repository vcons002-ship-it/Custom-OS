## kernel/buildroot-external/configs/clade_x86_64_defconfig
```kconfig
# Clade OS image — x86_64 reference (QEMU/KVM + virtio)
BR2_x86_64=y

# Prebuilt external toolchain: no toolchain compile, much faster first build.
# (Clade's own binaries are static musl and independent of this choice.)
BR2_TOOLCHAIN_EXTERNAL=y
BR2_TOOLCHAIN_EXTERNAL_BOOTLIN=y
BR2_TOOLCHAIN_EXTERNAL_BOOTLIN_X86_64_GLIBC_STABLE=y

# Kernel: hardware layer only, quiet, virtio for the QEMU reference machine
BR2_LINUX_KERNEL=y
BR2_LINUX_KERNEL_LATEST_VERSION=y
BR2_LINUX_KERNEL_USE_ARCH_DEFAULT_CONFIG=y
BR2_LINUX_KERNEL_NEEDS_HOST_LIBELF=y
BR2_LINUX_KERNEL_CONFIG_FRAGMENT_FILES="$(BR2_EXTERNAL_CLADE_PATH)/board/clade/kernel.fragment"

# No traditional userland: no shell as init, no getty. BusyBox stays for the
# recovery console only (docs/03-os-layer.md: a service door).
BR2_INIT_NONE=y
BR2_SYSTEM_BIN_SH_NONE=y
BR2_PACKAGE_BUSYBOX=y

# Clade IS the userland (prebuilt static binaries; see package/clade)
BR2_PACKAGE_CLADE=y

# Boot straight into weaved
BR2_ROOTFS_OVERLAY="$(BR2_EXTERNAL_CLADE_PATH)/board/clade/rootfs-overlay"
BR2_ROOTFS_POST_BUILD_SCRIPT="$(BR2_EXTERNAL_CLADE_PATH)/board/clade/post-build.sh"

# Image: ext4 root for -drive boot
BR2_TARGET_ROOTFS_EXT2=y
BR2_TARGET_ROOTFS_EXT2_4=y
BR2_TARGET_ROOTFS_EXT2_SIZE="512M"
```

## kernel/buildroot-external/package/clade/Config.in
```kconfig
config BR2_PACKAGE_CLADE
	bool "clade"
	help
	  Clade's userland: weaved (PID 1), the mind-plane services, and the
	  Weave. Prebuilt static (musl) binaries from the workspace at the
	  repository root; see package/clade/clade.mk.
```
